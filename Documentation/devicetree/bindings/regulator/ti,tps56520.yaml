## Documentation/devicetree/bindings/regulator/ti,tps56520.yaml
```yaml
# SPDX-License-Identifier: (GPL-2.0 OR BSD-2-Clause)
%YAML 1.2
---
$id: "http://devicetree.org/schemas/regulator/ti,tps56520.yaml#"
$schema: "http://devicetree.org/meta-schemas/core.yaml#"

title: TI TPS56520 Voltage Regulator

maintainers:
  - Jason Li <jason.li@cortina-access.com>

description: |
  This binding describes the TPS56520 voltage regulator from Texas Instruments.
  It is typically connected over I2C and provides a configurable output voltage
  used to power components such as CPUs or SoCs.

allOf:
  - $ref: "regulator.yaml#"

properties:
  compatible:
    const: "ti,tps56520"

  reg:
    maxItems: 1

  ti,default-uV:
    description: Default voltage in microvolts when enabled.
    $ref: /schemas/types.yaml#/definitions/uint32

required:
  - compatible
  - reg

unevaluatedProperties: false

examples:
  - |
    i2c {
      #address-cells = <1>;
      #size-cells = <0>;

      vdd_regulator: tps56520@37 {
        compatible = "ti,tps56520";
        reg = <0x37>;

        ti,default-uV = <900000>;

        regulator-name = "vdd-cpu";
        regulator-min-microvolt = <820000>;
        regulator-max-microvolt = <990000>;
        regulator-ramp-delay = <300000>;
        regulator-enable-ramp-delay = <300000>;
        regulator-boot-on;
        regulator-always-on;
      };
    };
```

## Documentation/devicetree/bindings/reset/cortina-access,rst-mgr.yaml
```yaml
# SPDX-License-Identifier: (GPL-2.0 OR BSD-2-Clause)
%YAML 1.2
---
$id: http://devicetree.org/schemas/iommu/cortina-access,rst-mgr.yaml#
$schema: http://devicetree.org/meta-schemas/core.yaml#

title: Cortina Access SoC reset controller Bindings

properties:
  compatible:
    const: cortina-access,rst-mgr

  reg:
    minItems: 1
    maxItems: 1

  reg-names:
    const: block_reset


Example:

    block_rst: reset-controller@f4320074 {
	    compatible = "cortina-access,rst-mgr";
	    reg = <0x0 0xf4320074 0x0 0x04>;
	    reg-names = "block_reset";
	    #reset-cells = <1>;
    };
```

## Documentation/devicetree/bindings/serial/cortina-access,serial.yaml
```yaml
# SPDX-License-Identifier: (GPL-2.0-only OR BSD-2-Clause)
%YAML 1.2
---
$id: http://devicetree.org/schemas/serial/serial.yaml#
$schema: http://devicetree.org/meta-schemas/core.yaml#

title: Cortina-Access Serial Interferace

maintainers:
  - Lee Jenfeng <jenfeng.lee@cortina-access.com>

properties:
  compatible:
    const: ortina-access,serial

  reg:
    maxItems: 1

  clocks:
    maxItems: 1

  interrupts:
    maxItems: 1

examples:
  - |
    uart0: uart@f43291cc {
        device_type = "serial";
        compatible = "cortina-access,serial";
        reg = <0x00000000 0xf43291cc 0x0 0x30>;
        clocks = <&apb_pclk>;
        interrupt-parent = <&gic>;
        interrupts = <GIC_SPI 4 IRQ_TYPE_LEVEL_HIGH>;
    };
```

## Documentation/devicetree/bindings/soc/cortina-access/cortina-access,ca-peri.yaml
```yaml
# SPDX-License-Identifier: (GPL-2.0 OR BSD-2-Clause)
# Copyright 2023 Cortina-Access
%YAML 1.2
---
$id: "http://devicetree.org/schemas/soc/cortina-access,ca-peri.yaml#"
$schema: "http://devicetree.org/meta-schemas/core.yaml#"

title: Cortina-Access peripheral interface driver for CA platform API

maintainers:
  - Yi Ding <yi.ding@cortina-access.com>

properties:
  compatible:
    const: cortina-access,ca-peri

  reg:
    items:
      - description: Control registers base address and length

required:
  - compatible
  - reg

additionalProperties: false

examples:
  - |
	ca_peri:ca_peri@0{
		compatible = "cortina-access,ca-peri";
		reg = <0x0 0xf4329018 0x0 0x460>,
		      <0x0 0xf4320000 0x0 0x200>,
		      <0x0 0xfff80800 0x0 0x10>,
		      <0x0 0xfff80000 0x0 0x400>;
		interrupt-parent = <&per_ictl>;
		interrupts = <3>;
		interrupt-names = "TMR2";
	};
```

## Documentation/devicetree/bindings/soc/cortina-access/cortina-access,ca8299-pll.yaml
```yaml
# SPDX-License-Identifier: (GPL-2.0 OR BSD-2-Clause)
# Copyright 2025 Cortina-Access
%YAML 1.2
---
$id: "http://devicetree.org/schemas/soc/cortina-access,ca8299-pll.yaml#"
$schema: "http://devicetree.org/meta-schemas/core.yaml#"

title: Cortina-Access peripheral clock driver for CA platform API

maintainers:
  - Ting Wu <ting.wu@cortina-access.com>

properties:
  compatible:
    const: cortina-access,ca8299-pll

  reg:
    items:
      - description: Control registers base address and length

required:
  - compatible
  - reg

additionalProperties: false

examples:
  - |
	glb_pll: pll@f4320274 {
		compatible = "cortina-access,ca8299-pll";
		reg = <0x0 0xf4320274 0x0 0x4>,
		      <0x0 0xf4320278 0x0 0x4>;
	};
```

## Documentation/devicetree/bindings/soc/cortina-access/cortina-access,venus.yaml
```yaml
# SPDX-License-Identifier: (GPL-2.0 OR BSD-2-Clause)
%YAML 1.2
---
$id: http://devicetree.org/schemas/iommu/cortina-access,venus.yaml#
$schema: http://devicetree.org/meta-schemas/core.yaml#

title: Cortina Access SoC Device Tree Bindings

properties:
  compatible:
    enum:
      - cortina-access,g3
      - cortina-access,g3hgu
      - cortina-access,saturn-sfu
      - cortina-access,venus
      - cortina-access,mercury

  reg:
    minItems: 2
    maxItems: 2

  reg-names:
    const: JTAG_ID

  clocks:
    minItems: 1
    items:
      - const: pll_cpll_clk
      - const: pll_epll_clk
      - const: pll_fpll_clk
      - const: cpu_daemon_clk
      - const: div_cci_clk
      - const: div_lsaxi_clk
      - const: div_core_clk
      - const: div_crypto_clk
      - const: mux_pe_clk
      - const: mux_peaxi_clk
      - const: factor_peripheral_clk

  clock-names:
    minItems: 1
    items:
      - const: cpll
      - const: epll
      - const: fpll
      - const: cpu_clk
      - const: cci_clk
      - const: lsaxi_clk
      - const: core_clk
      - const: crypto_clk
      - const: pe_clk
      - const: peaxi_clk
      - const: per_clk

  nvmem-cells:
    const: uuid

  nvmem-cell-names:
    const: uuid

required:
  - compatible
  - reg
  - reg-names
  - clock
  - clock-names
  - nvmem-cells
  - nvmem-cell-names

additionalProperties: false

examples:
  - |
    soc {
        compatible = "cortina-access,venus";
        reg = <0x00000000 0xf4320000 0x0 0x4>;
        reg-names = "JTAG_ID";

        clocks = <&pll_cpll_clk>, <&pll_epll_clk>, <&pll_fpll_clk>,
                 <&cpu_daemon_clk>, <&div_cci_clk>, <&div_lsaxi_clk>,
                 <&div_core_clk>, <&div_crypto_clk>, <&mux_pe_clk>,
                 <&mux_peaxi_clk>, <&factor_peripheral_clk>;
        clock-names = "cpll", "epll", "fpll",
                      "cpu_clk", "cci_clk", "lsaxi_clk",
                      "core_clk", "crypto_clk", "pe_clk",
                      "peaxi_clk", "per_clk";

        nvmem-cells = <&uuid>;
        nvmem-cell-names = "uuid";
    };
```

## Documentation/devicetree/bindings/spi/cortina-access,spi.yaml
```yaml
# SPDX-License-Identifier: (GPL-2.0 OR BSD-2-Clause)
%YAML 1.2
---
$id: http://devicetree.org/schemas/spi/cortina-access,spi.yaml#
$schema: http://devicetree.org/meta-schemas/core.yaml#

title: SPI driver for Cortina-Access platform, Inc.

maintainers:
  - Yi Ding <Yi.Ding@cortina-access.com>

description:
  This hardware spi is present on Cortina-Access platform.

properties:
  compatible:
    enum:
      - cortina-access,venus-spi
      - cortina-access,mercury-spi

  reg:
    maxItems: 2
    description:
      Hareware address of SPI controller

  clocks:
    maxItems: 1

  interrupts:
    maxItems: 1


required:
  - compatible
  - reg
  - clocks
  - interrupts

additionalProperties: false

examples:
  - |

/ {
	spi0: spi@f43290f4 {
		compatible = "cortina-access,mercury-spi";
		reg = <0x00000000 0xf43290f4 0x0 0x40>;
		reg-names = "spi_ctrl";
		interrupt-parent = <&per_ictl>;
		interrupts = <IRQ_PER_SPI>;
		clocks = <&apb_pclk>;
		#address-cells = <1>;
		#size-cells = <0>;
	};
};


...
```

## Documentation/devicetree/bindings/thermal/cortina-access,thermal-sensor.yaml
```yaml
# SPDX-License-Identifier: (GPL-2.0-only OR BSD-2-Clause)
%YAML 1.2
---
$id: http://devicetree.org/schemas/thermal/fsl,scu-thermal.yaml#
$schema: http://devicetree.org/meta-schemas/core.yaml#

title: Cortina-Access SOC thermal sensor

maintainers:
  - Jason Li<jason.li@cortina-access.com>

description: Cortina-Access SOC thermal sensor driver

allOf:
  - $ref: thermal-sensor.yaml#

properties:
  compatible:
    items:
      - const: cortina-access,thermal-sensor

reg:
  maxItems: 1
  description: >
  Address range for the thermal sensor registers

tms-reg-a:
  maxItems: 1
  description: >
  Thermal parameter in TMS_REG_A

tms-reg-b:
  maxItems: 1
  description: >
  Thermal parameter in TMS_REG_A

'#thermal-sensor-cells':
    const: 1

required:
  - compatible
  - reg
  - '#thermal-sensor-cells'


additionalProperties: false

examples:
  - |
      thermal@f43201ec {
          compatible = "cortina-access,thermal-sensor";
          reg = <0xf43201ec 0x14>;
      };
```

## Documentation/devicetree/bindings/usb/cortina-access,ca-xhci.yaml
```yaml
# SPDX-License-Identifier: (GPL-2.0-only OR BSD-2-Clause)
# Copyright 2024 Cortina-Access
%YAML 1.2
---
$id: http://devicetree.org/schemas/usb/cortina-access,ca-xhci.yaml#
$schema: http://devicetree.org/meta-schemas/core.yaml#

title: Cortina-Access SoC USB xHCI Controller

allOf:
  - $ref: "usb-hcd.yaml"

maintainers:
  - Pengpeng Chen <pengpeng.chen@cortina-access.com>

properties:
  compatible:
    const: cortina-access,ca-xhci

  reg:
    maxItems: 1

  reg-names:
    const: usb3-xhci-reg

  interrupts:
    maxItems: 1

  interrupt-parent:
    maxItems: 1

  usb-phy:
    maxItems: 1

required:
  - compatible
  - reg
  - reg-names
  - interrupts
  - interrupts-parent
  - usb-phy

additionalProperties: false

examples:
  - |
    usb3-xhci@f0200000 {
        compatible = "cortina-access,ca-xhci";
        reg = <0x0 0xf0200000 0x0 0xa8>;
        reg-names = "usb3-xhci-reg"
        interrupts = <GIC_SPI IRQ_GLB_USB3_1 IRQ_TYPE_LEVEL_HIGH>;
        interrupt-parent = <&gic>;
        usb-phy = <&usb_ssphy>;
    };

...
```

## Documentation/devicetree/bindings/usb/cortina-access,ca8289-u2phy.yaml
```yaml
# SPDX-License-Identifier: (GPL-2.0 OR BSD-2-Clause)
# Copyright 2024 Cortina-Access
%YAML 1.2
---
$id: "http://devicetree.org/schemas/phy/cortina-access,ca8289-u2phy.yaml#"
$schema: "http://devicetree.org/meta-schemas/core.yaml#"

title: Cortina-Access SoC USB2 PHY

maintainers:
  - Pengpeng Chen <pengpeng.chen@cortina-access.com>

properties:
  compatible:
     const: cortina-access,ca8289-u2phy

  reg:
    maxItems: 1

  reg-names:
    items:
      - const: u2host_reg

  resets:
    maxItems: 1

  reset-names:
    items:
      - const: usbcore_reset

  portnum:
    const: 3

  phy_data_size:
    const: 10

  phy_data_addr:
    const: 10

  phy_data_array:
    const: 10

  status:
    items:
      - const: disabled

required:
  - compatible
  - reg
  - reg-names
  - resets
  - reset-names
  - portnum
  - phy_data_size
  - phy_data_addr
  - phy_data_array
  - status

additionalProperties: false

examples:
  - |
    u2phy: usbphy@f432b028 {
        compatible = "cortina-access,ca8289-u2phy";
        reg = <0x0 0xf432b028 0x0 0x28>;
        reg-names = "u2host_reg";
        #address-cells = <2>;
        #size-cells = <2>;
        ranges;
        resets = <&block_rst USB_RESET>;
        reset-names = "usbcore_reset";

        /*
         * 0x0 -- NO usb2 ports enabled
         * 0x1 -- usb2 port0 only enabled
         * 0x2 -- usb2 port1 only enabled
         * 0x3 -- usb2 port1 and port0 enabled
         * 0x4 -- usb2 port2 only enabled
         * 0x5 -- usb2 port2 and port0 enabled
         * 0x6 -- usb2 port2 and port1 enabled
         * 0x7 -- all three usb2 ports enabled
         */
        u2portmask = <0x7>;

        phy_data_size = <10>;
        phy_data_addr = /bits/ 8
            <0xF4 0xE0 0xE0 0xF4 0xE0 0xE4 0xF5 0xF7 0xF4 0xE3>;
        phy_data_array = /bits/ 8
            <0xBB 0x21 0x25 0x9B 0x18 0x8B 0x01 0x32 0xBB 0x44>;
            /* 0x21->0x25 start calibration */
            /* Address 0xF4(bit#5) specify page number */
        status = "disabled";
    };
```

## Documentation/devicetree/bindings/usb/cortina-access,ca8289-u3phy.yaml
```yaml
# SPDX-License-Identifier: (GPL-2.0 OR BSD-2-Clause)
# Copyright 2024 Cortina-Access
%YAML 1.2
---
$id: "http://devicetree.org/schemas/phy/cortina-access,ca8289-u3phy.yaml#"
$schema: "http://devicetree.org/meta-schemas/core.yaml#"

title: Cortina-Access SoC USB3 PHY

maintainers:
  - Pengpeng Chen <pengpeng.chen@cortina-access.com>

properties:
  compatible:
    const: cortina-access,ca8289-u3phy

  reg:
    items:
      - description: PHY host control registers
      - description: PHY S2 serdes registers
      - description: PHY S3 serdes registers

  reg-names:
    items:
      - const: u3host_reg
      - const: s2_u3port0
      - const: s3_u3port1

  resets:
    items:
      - description: USB S2 serdes reset
      - description: USB S3 serdes reset

  reset-names:
    items:
      - const: s2u3_dphy_reset
      - const: s3u3_dphy_reset

  phys:
    minItems: 1
    maxItems: 2

  phy-names:
    minItems: 1
    maxItems: 2

  portmask:
    const: 3

  phy_data_size:
    const: 17

  phy_data_addr:
    const: 17

  phy_data_array:
    const: 17

  status:
    items:
      - const: disabled

required:
  - compatible
  - reg
  - reg-names
  - resets
  - reset-names
  - phys
  - phy-names
  - portmask
  - phy_data_size
  - phy_data_addr
  - phy_data_array
  - status

additionalProperties: false

examples:
  - |
    u3phy: usb3phy@f432b000 {
        compatible = "cortina-access,ca8289-u3phy";
        reg = <0x0 0xf432b000 0x0 0x28>,
              <0x0 0xf4337000 0x0 0x1000>,
              <0x0 0xf4338000 0x0 0x1000>;
        reg-names = "u3host_reg",
                    "s2_u3port0",
                    "s3_u3port1";
        #address-cells = <2>;
        #size-cells = <2>;
        ranges;
        resets = <&dphy_rst PHY_S2_USB_RESET>,
                 <&dphy_rst PHY_S3_USB_RESET>;
        reset-names = "s2u3_dphy_reset",
                      "s3u3_dphy_reset";
        phys = <&s2_usb_phy>,
               <&s3_usb_phy>;
        phy-names = "s2u3-phy",
                    "s3u3-phy";
        portmask = <0x3>; # 0x1 -- Enable S2/usb3 port0 only
                          # 0x2 -- Enable S3/usb3 port1 only
                          # 0x3 -- Enable S2 and S3 both all
        phy_data_size = <17>;
        phy_data_addr = /bits/ 8
                <0x01 0x26 0x2f 0x0a 0x06 0x23 0x20 0x21
                 0x22 0x27 0x08 0x0b 0x0e 0x0c 0x09 0x09 0x09>;
        phy_data_array = /bits/ 16
                <0xAC46 0x840E 0x8648 0xC608 0x000c 0xCB66 0x7069 0x68AA
                 0x0013 0x0266 0x3011 0xB905 0x1000 0xC008 0x524C 0x504C 0x524C>;
        status = "disabled";
    };
```
