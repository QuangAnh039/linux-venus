## Documentation/devicetree/bindings/usb/cortina-access,ca8299-u3phy.yaml
```yaml
# SPDX-License-Identifier: (GPL-2.0 OR BSD-2-Clause)
# Copyright 2024 Cortina-Access
%YAML 1.2
---
$id: "http://devicetree.org/schemas/phy/cortina,ca8299-u3phy.yaml#"
$schema: "http://devicetree.org/meta-schemas/core.yaml#"

title: Cortina-Access CA8299 SoC USB3 PHY

maintainers:
  - Pengpeng Chen <pengpeng.chen@cortina-access.com>

properties:
  compatible:
    const: cortina-access,ca8299-u3phy

  reg:
    items:
      - description: PHY host control registers
      - description: PHY S2 serdes registers
      - description: PHY S6 serdes registers
      - description: PHY S8 serdes registers

  reg-names:
    items:
      - const: u3host_reg
      - const: port0_reg
      - const: port1_reg
      - const: port2_reg

  resets:
    items:
      - description: USB S2 serdes reset
      - description: USB S6 serdes reset
      - description: USB S8 serdes reset

  reset-names:
    items:
      - const: u3s2_reset
      - const: u3s6_reset
      - const: u3s8_reset

  phys:
    minItems: 1
    maxItems: 2

  phy-names:
    minItems: 1
    maxItems: 2

  portmask:
    const: 2

  u2phy_data_size:
    const: 10

  u2phy_data_addr:
    const: 10

  u2phy_data_array:
    const: 10

  u3phy_data_size:
    const: 17

  u3phy_data_addr:
    const: 17

  u3phy_data_array:
    const: 17

  status:
    items:
      - const: disabled

required:
  - compatible
  - reg
  - reg-names
  - resets
  - reset-names
  - phys
  - phy-names
  - portmask
  - u2phy_data_size
  - u2phy_data_addr
  - u2phy_data_array
  - u3phy_data_size
  - u3phy_data_addr
  - u3phy_data_array
  - status

additionalProperties: false

examples:
  - |
    u3phy: usbphy@f432b000 {
        compatible = "cortina-access,ca8299-u3phy";
        reg = <0x0 0xf432b000 0x0 0x184>,
              <0x0 0xf4720000 0x0 0x8000>,
              <0x0 0xf4730000 0x0 0x8000>,
              <0x0 0xf4331000 0x0 0x8000>;
        reg-names = "u3host_reg", "u3s2_port0", "u3s6_port1", "u3s8_port2";
        ranges;
        resets = <&block_rst1 USB_S2_RESET>,
            <&block_rst1 USB_S6_RESET>,
            <&block_rst1 USB_S8_RESET>;
        reset-names ="u3s2_reset", "u3s6_reset", "u3s8_reset";
        phys = <&s2_usb_phy>, <&s6_usb_phy>, <&s8_usb_phy>;
        phy-names = "u3s2_phy", "u3s6_phy", "u3s8_phy";

        /*
         * 0x1 -- Enable U2port0/u3 S2
         * 0x2 -- Enable U2port1/u3 S6 (default)
         * 0x4 -- Enable U2port2/u3 S8
         */
        u2portmask = <0x2>;
        u3portmask = <0x2>;

        u2phy_data_size = <2>;
        u2phy_data_addr = /bits/ 8
            <0xE0 0xF4>;
        u2phy_data_array = /bits/ 8
            <0xEA 0x00>;

        u3phy_data_size = <64>;
        u3phy_data_addr = /bits/ 16
            <0x7100 0x46B0 0x4770 0x7030 0x0564 0x06A4 0x058C 0x06CC 0x0590 0x06D0
             0x0594 0x06D4 0x0598 0x06D8 0x05B0 0x06F0 0x0654 0x0794 0x0670 0x07B0
             0x46C0 0x4780 0x46C8 0x4788 0x7D48 0x7D88 0x7D60 0x7DA0 0x7D68 0x7DA8
             0x7D70 0x7DB0 0x7D78 0x7DB8 0x7D68 0x7DA8 0x0658 0x0658 0x0798 0x0798
             0x6320 0x6360 0x6330 0x6370 0x64C0 0x6500 0x64D8 0x6518 0x64D0 0x64C8
             0x6510 0x6508 0x64E8 0x64E0 0x6528 0x6520 0x6300 0x6300 0x6300 0x6340
             0x6340 0x6340 0x4650 0x4710>;
        u3phy_data_array = /bits/ 16
            <0x0001 0x0002 0x0002 0x3139 0x2500 0x2500 0x2002 0x2303 0x0168 0x0168
             0x0110 0x0110 0x1821 0x1821 0x0260 0x0260 0x6842 0x6842 0x003B 0x003B
             0xC1FC 0xC1FC 0xE87F 0xE87F 0x00C6 0x00C6 0x00C6 0x00C6 0x0080 0x0080
             0x0280 0x0280 0x0280 0x0280 0x0020 0x0020 0x0260 0x0360 0x0260 0x0360
             0x0949 0x0949 0x031A 0x031A 0x00C5 0x00C5 0x00C5 0x00C5 0x0001 0x999A
             0x0001 0x999A 0x0008 0xCCCD 0x0008 0xCCCD 0x0001 0x0003 0x0001 0x0001
             0x0003 0x0001 0x91C0 0x9100>;
        status = "disabled";
    };
```

## Documentation/devicetree/bindings/watchdog/cortina-access,wdt.yaml
```yaml
# SPDX-License-Identifier: (GPL-2.0 OR BSD-2-Clause)
%YAML 1.2
---
$id: http://devicetree.org/schemas/watchdog/cortina-access,wdt.yaml#
$schema: http://devicetree.org/meta-schemas/core.yaml#

title: Watchdog driver for Cortina-Access platform, Inc.

maintainers:
  - Jason Li <jason.li@cortina-access.com>

description:
  This hardware watchdog is present on Cortina-Access platform.

properties:
  compatible:
    enum:
      - cortina-access,wdt

  reg:
    maxItems: 2
    description:
      Hareware address of WDT controller

  clocks:
    maxItems: 1

  interrupts:
    maxItems: 1

  reset-on-timeout:
    Enable HW reset in when WDT timeout.

required:
  - compatible
  - reg
  - clocks
  - interrupts

additionalProperties: false

examples:
  - |

/ {
	wdt: wdt@f432901c {
        compatible = "cortina-access,wdt";
        reg = <0x0 0xf432901c 0x0 0x30>,
              <0x0 0xf4320020 0x0 0x04>;
        interrupt-parent = <&per_ictl>;
        interrupts = <IRQ_PER_WDT>;
        clocks = <&apb_pclk>;
        reset-on-timeout;
        delay-reset = <134>; /* Millisecond, maximum is 134ms */
    };
};


...
```

## arch/arm64/Kconfig.cortina-access
```kconfig
config ARCH_CORTINA_ACCESS
	bool "Cortina-Access SoC Family"
	select GPIOLIB
	select SOC_BUS
	help
	  This enables support for Cortina-Access SoC Family

choice
	prompt "Cortina-Access Arch Type"
	depends on ARCH_CORTINA_ACCESS
	default ARCH_CA_MERCURY
	help
	  Choose the Cortina Access' arch type

	config ARCH_CA_MERCURY
		bool "Mercury(CA-8299)"
		select GENERIC_IRQ_CHIP
		help
		  Cortina Access Mercury SoC

	config ARCH_CA_VENUS
		bool "Venus(CA-8289)"
		select GENERIC_IRQ_CHIP
		help
		  Cortina Access Venus SoC
endchoice

config CORTINA_ACCESS_BOARD_FPGA
	bool "FPGA Board"
	depends on ARCH_CORTINA_ACCESS
	default n
	help
	  Cortina-Access FPGA Board

config CORTINA_ACCESS_SMCC
	bool
	depends on ARCH_CA_VENUS
	default y
	help
	  SMC call for Cortina ARMv8 platform

source "arch/arm64/Kconfig.hook"
```

## arch/arm64/Kconfig.hook
```kconfig
# SPDX-License-Identifier: GPL-2.0

config CA_KERNEL_HOOK
	bool "Cortina-Access Kernel Hook Support"
	depends on ARCH_CORTINA_ACCESS
	select NETFILTER
	default n
	help
	  This enables kernel-hook support for NI driver hardware
	  acceleration.

	  If you would like to have NI driver hardware acceleration support,
	  say 'Y'.
```

## drivers/clk/cortina-access/Kconfig
```kconfig
config COMMON_CLK_CA8299
	bool "Cortina Access CA8299 (Mercury) Clock Driver"
	depends on ARCH_CA_MERCURY
	select COMMON_CLK_CORTINA_ACCESS
	help
	  The driver supports Cortina Access CA8299 clock driver based on the
	  common clock framework.
	  This is essetnail driver.
   	  Say Y to power up Cortina Access SOCs without doubts.

config COMMON_CLK_CA8289
	bool "Cortina-Access CA8289 (Venus) Clock Driver"
	depends on ARCH_CA_VENUS
	help
	  Build the Cortina-Access CA8289 clock driver based on the common
	  clock framework.
```

## drivers/crypto/rtk_crypto/Kconfig
```kconfig
# SPDX-License-Identifier: GPL-2.0-only
config CRYPTO_DEV_RTK
	tristate "RTK crypto driver"
	select CRYPTO_AEAD
	select CRYPTO_SKCIPHER
	select CRYPTO_ENGINE
	help
          Enable support for the Realtek hardware cryptographic accelerator.
          This driver provides cryptographic operations. It is designed to offload
	  cryptographic computations to dedicated hardware, improving performance
	  and reducing CPU usage.

          If you enable this option, the driver will be compiled as a module or 
          built-in, depending on your selection. It depends on the presence of 
          a compatible Realtek cryptographic engine in your system.

          Select 'M' to compile it as a loadable module, or 'Y' 
          to include it directly in the kernel image.

choice
	prompt "CRYPTO DEV RTK VER"
	depends on CRYPTO_DEV_RTK
	default CRYPTO_DEV_RTK_TAURUS
	help
          Select the version of the Realtek cryptographic hardware
          accelerator supported by the driver. Depending on your platform,
          choose the appropriate hardware version.

          - TAURUS: For Realtek TAURUS cryptographic accelerator.
          - MERCURY: For Realtek MERCURY cryptographic accelerator.

config CRYPTO_DEV_RTK_TAURUS
	bool "RTK_TAURUS"
	help
          Enable support for the Realtek TAURUS cryptographic accelerator.
          This version is designed for specific Realtek platforms that include
          the TAURUS hardware. Selecting this option ensures compatibility
          with TAURUS-specific features and optimizations.

config CRYPTO_DEV_RTK_MERCURY
	bool "RTK_MCRCURY"
	help
          Enable support for the Realtek MERCURY cryptographic accelerator.
          This version is tailored for Realtek platforms with the MERCURY
          hardware. Choose this option to leverage MERCURY-specific
          functionalities and optimizations.
endchoice
```

## drivers/phy/cortina-access/Kconfig
```kconfig
# SPDX-License-Identifier: GPL-2.0-only
#
# Phy drivers for Cortina-Access SoCs PHYs
#
config PHY_CA8299
	tristate "Cortina Access CA8299 PHY Support"
	depends on OF
	depends on ARCH_CORTINA_ACCESS || COMPILE_TEST
	select GENERIC_PHY
	help
	  Choose this option if you want to add CA8299
	  SoC PHY support in your system.
	  If unsure, say N.
	  This framework is designed to provide a generic interface for PHY
	  devices present in the kernel. This layer will have the generic
	  API by which phy drivers can create PHY using the phy framework and
	  phy users can obtain reference to the PHY. All the users of this
	  framework should select this config.

config PHY_CA8289
	tristate "Cortina Access SoCs PHY driver"
	depends on OF
	depends on ARCH_CORTINA_ACCESS || COMPILE_TEST
	select GENERIC_PHY
	help
	  Choose this option if you want to add Cortina
	  Access SoCs(which except CA8299) PHY support.
	  If unsure, say N.
```

## drivers/soc/cortina-access/Kconfig
```kconfig
# SPDX-License-Identifier: GPL-2.0-only

config ARCH_CA_PLL_S2IDLE
	tristate "CA PLL s2idle ops support"
	depends on SUSPEND
	help
	  This option enables support for the s2idle
	  ops sacling the pll clock rate during
	  s2idle suspend/resume flow.

	  Enable the option to reduce the pll clock
	  rate in the s2idle mode.
```

## drivers/thermal/cortina-access/Kconfig
```kconfig
# SPDX-License-Identifier: GPL-2.0-only
#
# Generic thermal drivers configuration
#

config CA_THERMAL
	tristate "Cortina-Access thermal driver"
	depends on ARCH_CORTINA_ACCESS && THERMAL_OF
	help
	  Support for Temperature Monitor (TEMPMON) found on  Cortina-Access
	  SoCs with system controller inside, Linux kernel has to communicate
	  with system controller via MU (message unit) IPC to get temperature
	  from thermal sensor. It supports one critical trip point and one
	  passive trip point on thermal sensor.
```
