## Documentation/devicetree/bindings/clock/cortina-access/cortina-access,mercury-daemon-clk.yaml
```yaml
# SPDX-License-Identifier: (GPL-2.0-only OR BSD-2-Clause)
%YAML 1.2
---
$id: http://devicetree.org/schemas/clock/cortina-access,mercury-daemon-clk.yaml#
$schema: http://devicetree.org/meta-schemas/cortina-access-mercury-daemon-clk.yaml#

title: Cortina-Access Mercury platform Daemon Clock Device Tree Bindings

maintainers:
  - Arthur <arthur.li@cortina-access.com>

deprecated: true

properties:
  "#clock-cells":
    const: 0

  compatible:
    enum:
      - cortina-access,ca8299-pe-daemon-clk
      - cortina-access,ca8299-cpu-daemon-clk
  reg:
    maxItems: 1

  clocks:
    minItems: 1
    maxItems: 5
    description: >
      The parent order must match the hardware programming order.

required:
  - "#clock-cells"
  - compatible
  - clocks
  - init-speed

additionalProperties: false

allOf:
  - if:
      properties:
        compatible:
          contains:
            const: cortina-access,ca8299-pe-daemon-clk

    then:
      properties:
        clocks:
          maxItems: 4

  - if:
      properties:
        compatible:
          contains:
            const: cortina-access,ca8299-cpu-daemon-clk

    then:
      properties:
        clocks:
          maxItems: 5
examples:
  - |
    pe_daemon_clk: pe_daemon {
        compatible = "cortina-access,ca8299-pe-daemon-clk";
        #clock-cells = <0>;
        clocks = <&fixed_reference_clk>,
                 <&pll_fpll_clk>,
                 <&div_f_clk>,
                 <&mux_pe_clk>;
        init-speed = <800000000>;
    };
  - |
    cpu_daemon_clk: cpu_daemon {
        compatible = "cortina-access,ca8299-cpu-daemon-clk";
        #clock-cells = <0>;
        clocks = <&fixed_reference_clk>,
                 <&pll_cpll_clk>,
                 <&div_f2c_clk>,
                 <&mux_cpu_clk>,
                 <&div_cortex_clk>;
        init-speed = <1200000000>;
        /* read-only; */
    };

...
```

## Documentation/devicetree/bindings/clock/cortina-access/cortina-access,mercury-div-clk.yaml
```yaml
# SPDX-License-Identifier: (GPL-2.0-only OR BSD-2-Clause)
%YAML 1.2
---
$id: http://devicetree.org/schemas/clock/cortina-access,mercury-div-clk.yaml#
$schema: http://devicetree.org/meta-schemas/cortina-access-mercury-div-clk.yaml#

title: Cortina-Access Mercury platform Divider Clock Device Tree Bindings

maintainers:
  - Arthur <arthur.li@cortina-access.com>

deprecated: true

properties:
  "#clock-cells":
    const: 0

  compatible:
    enum:
      - cortina-access,div-cpll-clk
      - cortina-access,div-fpll-clk
      - cortina-access,div-epll-clk
      - cortina-access,div-epll2-clk
  reg:
    maxItems: 1

  clocks:
    minItems: 2
    maxItems: 4
    description: >
      The parent order must match the hardware programming order.

required:
  - "#clock-cells"
  - compatible
  - clocks
  - operate-shift
  - operate-width

additionalProperties: false

allOf:
  - if:
      properties:
        compatible:
          contains:
            const: cortina-access,div-cpll-clk

    then:
      properties:
        clocks:
          maxItems: 1

  - if:
      properties:
        compatible:
          contains:
            const: cortina-access,div-fpll-clk

    then:
      properties:
        clocks:
          maxItems: 1

  - if:
      properties:
        compatible:
          contains:
            const: cortina-access,div-epll-clk

    then:
      properties:
        clocks:
          maxItems: 1

  - if:
      properties:
        compatible:
          contains:
            const: cortina-access,div-fpl2-clk

    then:
      properties:
        clocks:
          maxItems: 1
examples:
  - |
    div_f2c_clk: div_f2c {
        compatible = "cortina-access,div-cpll-clk";
        #clock-cells = <0>;
        clocks = <&pll_fpll_clk>;
        operate-shift = /bits/ 8 <CA8299_CPLLDIV_F2C_OFFSET>;
        operate-width = /bits/ 8 <CA8299_CPLLDIV_F2C_SIZE>;
    };
  - |

    div_peaxi_clk: div_peaxi {
        compatible = "cortina-access,div-fpll-clk";
        #clock-cells = <0>;
        clocks = <&mux_pe_clk>;
        operate-shift = /bits/ 8 <CA8299_FPLLDIV_PEAXI_OFFSET>;
        operate-width = /bits/ 8 <CA8299_FPLLDIV_PEAXI_SIZE>;
        init-div = /bits/ 8 <2>;
    };
  - |
    div_crypto_clk: div_crypto {
        compatible = "cortina-access,div-epll-clk";
        #clock-cells = <0>;
        clocks = <&pll_epll_clk>;
        operate-shift = /bits/ 8 <CA8299_EPLLDIV_DW_PER_OFFSET>;
        operate-width = /bits/ 8 <CA8299_EPLLDIV_DW_PER_SIZE>;
        init-div = /bits/ 8 <6>;
    };
  - |
    div_cci_clk: div_cci {
        compatible = "cortina-access,div-epll2-clk";
        #clock-cells = <0>;
        clocks = <&pll_epll_clk>;
        operate-shift = /bits/ 8 <CA8299_EPLLDIV2_CCI_OFFSET>;
        operate-width = /bits/ 8 <CA8299_EPLLDIV2_CCI_SIZE>;
        init-div = /bits/ 8 <5>;
    };
...
```

## Documentation/devicetree/bindings/clock/cortina-access/cortina-access,mercury-fixed-factor-clk.yaml
```yaml
# SPDX-License-Identifier: (GPL-2.0-only OR BSD-2-Clause)
%YAML 1.2
---
$id: http://devicetree.org/schemas/clock/cortina-access,mercury-fixed-factor-clk.yaml#
$schema: http://devicetree.org/meta-schemas/cortina-access-mercury-fixed-factor-clk.yaml#

title: Cortina-Access Mercury platform Fixed Factor Clock Device Tree Bindings

maintainers:
  - Arthur <arthur.li@cortina-access.com>

deprecated: true

properties:
  "#clock-cells":
    const: 0

  compatible:
    enum:
      - cortina-access,fixed-factor-clk
  reg:
    maxItems: 1

  clocks:
    minItems: 1
    maxItems: 4
    description: >
      The parent order must match the hardware programming order.

required:
  - "#clock-cells"
  - compatible
  - clocks
  - fixed-div

additionalProperties: false

allOf:
  - if:
      properties:
        compatible:
          contains:
            const: cortina-access,fixed-factor-clk

    then:
      properties:
        clocks:
          maxItems: 1

examples:
  - |
    factor_peripheral_clk: factor_peripheral {
        compatible = "cortina-access,fixed-factor-clk";
        #clock-cells = <0>;
        clocks = <&pll_epll_clk>;
        fixed-div = <16>;
    };
  - |
    factor_usb_suspend_clk: factor_usb_suspend {
        compatible = "cortina-access,fixed-factor-clk";
        #clock-cells = <0>;
        clocks = <&pll_epll_clk>;
        fixed-div = <200>;
    };
...
```

## Documentation/devicetree/bindings/clock/cortina-access/cortina-access,mercury-gate-config-clk.yaml
```yaml
# SPDX-License-Identifier: (GPL-2.0-only OR BSD-2-Clause)
%YAML 1.2
---
$id: http://devicetree.org/schemas/clock/cortina-access,mercury-gate-config-clk.yaml#
$schema: http://devicetree.org/meta-schemas/cortina-access-mercury-gate-config-clk.yaml#

title: Cortina-Access Mercury platform Gate Clock Device Tree Bindings

maintainers:
  - Arthur <arthur.li@cortina-access.com>

deprecated: true

properties:
  "#clock-cells":
    const: 0

  compatible:
    enum:
      - cortina-access,gate-config-clk
  reg:
    maxItems: 1

  clocks:
    minItems: 1
    maxItems: 5
    description: >
      The parent order must match the hardware programming order.

required:
  - "#clock-cells"
  - compatible

additionalProperties: false

allOf:
  - if:
      properties:
        compatible:
          contains:
            const: cortina-access,gate-config-clk

    then:
      properties:
        clocks:
          maxItems: 5

examples:
  - |
    gate_pcie0_clk: gate_pcie0 {
        compatible = "cortina-access,gate-config-clk";
        #clock-cells = <0>;
        operate-shift = /bits/ 8 <CA8299_CFG_CLKEN_PCIE0>;
    };

...
```

## Documentation/devicetree/bindings/clock/cortina-access/cortina-access,mercury-mux-clk.yaml
```yaml
# SPDX-License-Identifier: (GPL-2.0-only OR BSD-2-Clause)
%YAML 1.2
---
$id: http://devicetree.org/schemas/clock/cortina-access,mercury-mux-clk.yaml#
$schema: http://devicetree.org/meta-schemas/cortina-access-mercury-mux-clk.yaml#

title: Cortina-Access Mercury platform Mux Clock Device Tree Bindings

maintainers:
  - Arthur <arthur.li@cortina-access.com>

deprecated: true

properties:
  "#clock-cells":
    const: 0

  compatible:
    enum:
      - cortina-access,mux-cpu-clk
      - cortina-access,mux-pe-clk
  reg:
    maxItems: 1

  clocks:
    minItems: 2
    maxItems: 4
    description: >
      The parent order must match the hardware programming order.

required:
  - "#clock-cells"
  - compatible
  - clocks
  - operate-shift

additionalProperties: false

allOf:
  - if:
      properties:
        compatible:
          contains:
            const: cortina-access,mux-cpu-clk

    then:
      properties:
        clocks:
          maxItems: 1

  - if:
      properties:
        compatible:
          contains:
            const: cortina-access,mux-pe-clk

    then:
      properties:
        clocks:
          maxItems: 1

examples:
  - |
    mux_cpu_clk: mux_cpu {
        compatible = "cortina-access,mux-cpu-clk";
        #clock-cells = <0>;
        clocks = <&pll_cpll_clk>, <&div_f2c_clk>;
        operate-shift = /bits/ 8 <CA8299_CPLLDIV_CF_SEL>;
    };
  - |
    mux_pe_clk: mux_pe {
        compatible = "cortina-access,mux-pe-clk";
        #clock-cells = <0>;
        clocks = <&div_f_clk>, <&div_c2f_clk>;
        operate-shift = /bits/ 8 <CA8299_PEDIV_OFFLOAD_SEL>;
    };


...
```

## Documentation/devicetree/bindings/clock/cortina-access/cortina-access,mercury-pll-clk.yaml
```yaml
# SPDX-License-Identifier: (GPL-2.0-only OR BSD-2-Clause)
%YAML 1.2
---
$id: http://devicetree.org/schemas/clock/cortina-access,mercury-pll-clk.yaml#
$schema: http://devicetree.org/meta-schemas/cortina-access-mercury-pll-clk.yaml#

title: Cortina-Access Mercury PLL Clock Device Tree Bindings

maintainers:
  - Arthur <arthur.li@cortina-access.com>

deprecated: true

properties:
  "#clock-cells":
    const: 0

  compatible:
    enum:
      - cortina-access,ca8299-pll-cpll-clk
      - cortina-access,ca8299-pll-fpll-clk
      - cortina-access,ca8299-pll-epll-1p5g-clk
      - cortina-access,ca8299-pll-epll-1p2g-clk
      - cortina-access,ca8299-pll-epll-1g-clk

  reg:
    maxItems: 1

  clocks:
    minItems: 1
    maxItems: 4
    description: >
      The parent order must match the hardware programming order.

  clock-output-names:
    maxItems: 1

required:
  - "#clock-cells"
  - compatible
  - clocks

additionalProperties: false

allOf:
  - if:
      properties:
        compatible:
          contains:
            const: cortina-access,ca8299-pll-cpll-clk

    then:
      properties:
        clocks:
          maxItems: 1

  - if:
      properties:
        compatible:
          contains:
            const: cortina-access,ca8299-pll-fpll-clk

    then:
      properties:
        clocks:
          maxItems: 1

  - if:
      properties:
        compatible:
          contains:
            const: cortina-access,ca8299-pll-epll-clk

    then:
      properties:
        clocks:
          maxItems: 1

examples:
  - |
    pll_cpll_clk: pll_cpll {
        compatible = "cortina-access,ca8299-pll-cpll-clk";
        #clock-cells = <0>;
        clocks = <&fixed_reference_clk>;
        /* init-mult = /bits/ 8 <48>; */
    };

  - |
    pll_fpll_clk: pll_fpll {
        compatible = "cortina-access,ca8299-pll-fpll-clk";
        #clock-cells = <0>;
        clocks = <&fixed_reference_clk>;
        /* init-mult = /bits/ 8 <80>; */
    };

  - |

    pll_epll_clk: pll_epll {
        compatible = "cortina-access,ca8299-pll-epll-clk";
        #clock-cells = <0>;
        clocks = <&fixed_reference_clk>;
        /* init-mult = /bits/ 8 <64>; */
    };
...
```

## Documentation/devicetree/bindings/clock/cortina-access/cortina-access,mercury-soc-clk.yaml
```yaml
# SPDX-License-Identifier: (GPL-2.0-only OR BSD-2-Clause)
%YAML 1.2
---
$id: http://devicetree.org/schemas/clock/cortina-access,mercury-soc-clk.yaml#
$schema: http://devicetree.org/meta-schemas/cortina-access-mercury-soc-clk.yaml#

title: Cortina-Access Mercury SOC Clock Device Tree Bindings

maintainers:
  - Arthur <arthur.li@cortina-access.com>

deprecated: true

properties:
  "#clock-cells":
    const: 0

  compatible:
    enum:
      - cortina-access,ca8299-soc-clks

  reg:
    maxItems: 1

  clocks:
    minItems: 1
    maxItems: 4
    description: >
      The parent order must match the hardware programming order.

  clock-output-names:
    maxItems: 1

required:
  - "#clock-cells"
  - compatible
  - clocks

additionalProperties: false

allOf:
  - if:
      properties:
        compatible:
          contains:
            const: cortina-access,ca8299-soc-clks

    then:
      properties:
        clocks:
          maxItems: 1

examples:
  - |
    soc_clks {
            compatible = "cortina-access,ca8299-soc-clks";
            reg = <0x0 0xf4320000 0x0 0x01d0>;
            #address-cells = <1>;
            #size-cells = <0>;
    }
...
```
