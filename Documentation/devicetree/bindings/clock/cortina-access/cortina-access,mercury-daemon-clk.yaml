## Documentation/devicetree/bindings/net/cortina-access,mdio.yaml
```yaml
# SPDX-License-Identifier: (GPL-2.0 OR BSD-2-Clause)
# Copyright 2025 Cortina-Access
%YAML 1.2
---
$id: "http://devicetree.org/schemas/interrupt-controller/cortina-access,mdio.yaml#"
$schema: "http://devicetree.org/meta-schemas/core.yaml#"

title: Cortina-Access MDIO bus controller

maintainers:
  - Pengpeng Chen <pengpeng.chen@cortina-access.com>

allOf:
  - $ref: mdio.yaml#

properties:
  compatible:
    const: cortina-access,mdio

  reg:
    items:
      - description: Control registers base address and length

  clocks:
    description: A reference to the clock supplying the MDIO bus controller

  clock-frequency:
    description: >
      The MDIO bus clock that must be output by the MDIO bus hardware, if
      absent, the default hardware values are used

required:
  - compatible
  - reg

additionalProperties: false

examples:
  - |
	  mdio: mdio@f4329134 {
		  compatible = "cortina-access,mdio";
		  reg = <0x0 0xf4329134 0x0 0x48>;
		  interrupt-parent = <&per_ictl>;
		  interrupts = <IRQ_PER_MDIO>;
		  clocks = <&apb_pclk>;
		  peri-clock-frequency = <125000000>;
		  clock-frequency = <2500000>;
	  };
```

## Documentation/devicetree/bindings/net/cortina-access,ni.yaml
```yaml
# SPDX-License-Identifier: (GPL-2.0 OR BSD-2-Clause)
# Copyright 2023 Cortina-Access
%YAML 1.2
---
$id: "http://devicetree.org/schemas/interrupt-controller/cortina-access,ni.yaml#"
$schema: "http://devicetree.org/meta-schemas/core.yaml#"

title: Cortina-Access Network Interface

maintainers:
  - Aaron Tseng <aaron.tseng@cortina-access.com>

allOf:
  - $ref: ethernet-controller.yaml#

properties:
  compatible:
    const: cortina-access,ni

  reg:
    items:
      - description: Control registers base address and length

required:
  - compatible
  - reg

unevaluatedProperties: false

examples:
  - |
    ethernet: ethernet@f4300000  {
				compatible = "cortina-access,ni";
				reg = <0x0 0xf4300000  0x0 0x10000>;
				#interrupt-cells = <4>;
				interrupt-parent = <&gic>;
				interrupts = <GIC_SPI IRQ_GLB_QM_CPU0 IRQ_TYPE_LEVEL_HIGH>,
					     <GIC_SPI IRQ_GLB_QM_CPU1 IRQ_TYPE_LEVEL_HIGH>,
					     <GIC_SPI IRQ_GLB_QM_CPU2 IRQ_TYPE_LEVEL_HIGH>,
					     <GIC_SPI IRQ_GLB_QM_CPU3 IRQ_TYPE_LEVEL_HIGH>;
	};
```

## Documentation/devicetree/bindings/nvmem/cortina-access,ca-efuse.yaml
```yaml
# SPDX-License-Identifier: (GPL-2.0 OR BSD-2-Clause)
%YAML 1.2
---
$id: http://devicetree.org/schemas/watchdog/cortina-access,ca-efuse.yaml#
$schema: http://devicetree.org/meta-schemas/core.yaml#

title: OTP driver for Cortina-Access platform, Inc.

maintainers:
  - Jason Li <jason.li@cortina-access.com>

description:
  This hardware watchdog is present on Cortina-Access platform.

properties:
  compatible:
    enum:
      - cortina-access,ca-efuse
```

## Documentation/devicetree/bindings/pci/cortina-access,ca8289-pcie.yaml
```yaml
# SPDX-License-Identifier: (GPL-2.0 OR BSD-2-Clause)
# Copyright 2024 Cortina-Access
%YAML 1.2
---
$id: "http://devicetree.org/schemas/pci/cortina-access,ca8289-pcie.yaml#"
$schema: "http://devicetree.org/meta-schemas/core.yaml#"

title: Cortina-Access Venus PCIE

maintainers:
  - Eason Chiang <eason.chiang@cortina-access.com>

properties:
  compatible:
     const: cortina-access,venus-pcie

  reg:
    maxItems: 1

  reg-names:
    items:
      - const: glbl_regs, rc_dbi, config, iatu, serdes_phy

required:
  - compatible
  - reg
  - reg-names
  - phy-names

additionalProperties: false

examples:
  - |
		pcie0: pcie@f4325000 {
				compatible = "cortina-access,venus-pcie";
				reg = <0x0 0xf4325000 0x0 0x00000400>,
					<0x0 0xa0000000 0x0 0x00001000>,
					<0x0 0xa0001000 0x0 0x00002000>,
					<0x0 0xa0300000 0x0 0x00100000>,
					<0x0 0xf4333000 0x0 0x00002000>;
				reg-names = "glbl_regs", "rc_dbi", "config", "iatu", "serdes_phy";

				phys = <&s0_pcie_phy0>, <&s0_pcie_phy1>;
				phy-names = "pcie-phy0", "pcie-phy1";

				#address-cells = <3>;
				#size-cells = <2>;

				device_type = "pci";
				linux,pci-domain = <0>;
				bus-range = <0x0 0xff>;
				ranges = /* I/O */
						<0x81000000 0 0x00000000 0 0xa0003000 0 0x002fd000>,
						/* non-prefetchable memory */
						<0x82000000 0 0xa0400000 0 0xa0400000 0 0x0fc00000>;
				id = <0>;
				num-lanes = <2>;
				num-viewport = <1>;
				clocks = <&gate_pcie0_clk>;

				interrupt-parent = <&gic>;
				#interrupt-cells = <1>;
				interrupts = <GIC_SPI IRQ_GLB_PCI_0 IRQ_TYPE_LEVEL_HIGH>;

				interrupt-map-mask = <0 0 0 7>;
				interrupt-map = <0 0 0 1 &pcie0_intc 0>, /* INT A */
								<0 0 0 2 &pcie0_intc 1>, /* INT B */
								<0 0 0 3 &pcie0_intc 2>, /* INT C */
								<0 0 0 4 &pcie0_intc 3>; /* INT D */

				pcie0_intc: interrupt-controller {
						interrupt-controller;
						#address-cells = <0>;
						#interrupt-cells = <1>;
						interrupt-parent = <&gic>;
				};
		};

		pcie1: pcie@f4326000 {
				compatible = "cortina-access,venus-pcie";
				reg = <0x0 0xf4326000 0x0 0x00000400>,
					<0x0 0xb0000000 0x0 0x00001000>,
					<0x0 0xb0001000 0x0 0x00002000>,
					<0x0 0xb0300000 0x0 0x00100000>,
					<0x0 0xf4335000 0x0 0x00002000>;
				reg-names = "glbl_regs", "rc_dbi", "config", "iatu", "serdes_phy";
				#address-cells = <3>;
				#size-cells = <2>;
				device_type = "pci";
				linux,pci-domain = <1>;
				bus-range = <0x0 0xff>;
				ranges = /* I/O */
						<0x81000000 0 0x00000000 0 0xb0003000 0 0x002fd000>,
						/* non-prefetchable memory */
						<0x82000000 0 0xb0400000 0 0xb0400000 0 0x0fc00000>;

				id = <1>;
				num-lanes = <2>;
				num-viewport = <1>;
				clocks = <&gate_pcie1_clk>;

				phys = <&s1_pcie_phy0>, <&s1_pcie_phy1>;
				phy-names = "pcie-phy0", "pcie-phy1";

				//iommus = <&pcie1_atu>;

				interrupt-parent = <&gic>;
				interrupts = <GIC_SPI IRQ_GLB_PCI_1 IRQ_TYPE_LEVEL_HIGH>;
				/* controller interrupt */

				#interrupt-cells = <1>;
				interrupt-map-mask = <0 0 0 7>;
				interrupt-map = <0 0 0 1 &pcie1_intc 0>, /* INT A */
								<0 0 0 2 &pcie1_intc 1>, /* INT B */
								<0 0 0 3 &pcie1_intc 2>, /* INT C */
								<0 0 0 4 &pcie1_intc 3>; /* INT D */
				pcie1_intc: interrupt-controller {
						interrupt-controller;
						#address-cells = <0>;
						#interrupt-cells = <1>;
				};
		};

		pcie2: pcie@f4327000 {
				compatible = "cortina-access,venus-pcie";
				reg = <0x0 0xf4327000 0x0 0x00000400>,
					<0x0 0xc0000000 0x0 0x00001000>,
					<0x0 0xc0001000 0x0 0x00002000>,
					<0x0 0xc0300000 0x0 0x00100000>,
					<0x0 0xf4337000 0x0 0x00001000>;
				reg-names = "glbl_regs", "rc_dbi", "config", "iatu", "serdes_phy";
				#address-cells = <3>;
				#size-cells = <2>;
				device_type = "pci";
				linux,pci-domain = <2>;
				bus-range = <0x0 0xff>;
				ranges = /* I/O */
						<0x81000000 0 0x00000000 0 0xc0003000 0 0x002fd000>,
						/* non-prefetchable memory */
						<0x82000000 0 0xc0400000 0 0xc0400000 0 0x0fc00000>;

				id = <2>;
				num-lanes = <1>;
				num-viewport = <1>;
				clocks = <&gate_pcie2_clk>;

				phys = <&s2_pcie_phy0>;
				phy-names = "pcie-phy0";

				//iommus = <&pcie2_atu>;

				interrupt-parent = <&gic>;
				interrupts = <GIC_SPI IRQ_GLB_PCI_2 IRQ_TYPE_LEVEL_HIGH>;
				/* controller interrupt */

				#interrupt-cells = <1>;
				interrupt-map-mask = <0 0 0 7>;
				interrupt-map = <0 0 0 1 &pcie2_intc 0>, /* INT A */
								<0 0 0 2 &pcie2_intc 1>, /* INT B */
								<0 0 0 3 &pcie2_intc 2>, /* INT C */
								<0 0 0 4 &pcie2_intc 3>; /* INT D */
				pcie2_intc: interrupt-controller {
						interrupt-controller;
						#address-cells = <0>;
						#interrupt-cells = <1>;
				};
		};
```
