## Documentation/devicetree/bindings/crypto/cortina-access,ca8289-crypto.yaml
```yaml
# SPDX-License-Identifier: (GPL-2.0 OR BSD-2-Clause)
# Copyright 2024 Cortina-Access
%YAML 1.2
---
$id: "http://devicetree.org/schemas/crypto/cortina-access,ca8289-crypto.yaml#"
$schema: "http://devicetree.org/meta-schemas/core.yaml#"

title: Cortina-Access Venus SPACC Crypto

maintainers:
  - Eason Chiang <eason.chiang@cortina-access.com>

properties:
  compatible:
     const: ca,ca8289-crypto
     const: cortina,ca77xx-mpm
     const: cortina,ca77xx-clp800
     const: ca,ca8289-spacc

  reg:
    maxItems: 1

  reg-names:
    items:
      - const: glbl_regs, rc_dbi, config, iatu, serdes_phy

required:
  - compatible
  - reg


additionalProperties: false

examples:
  - |
	crypto0: crypto@90500000 {
		compatible = "ca,ca8289-crypto";
		#address-cells = <1>;
		#size-cells = <1>;
		reg = <0x0 0x90500000 0x0 0x8000>;
		ranges = <0x0 0x0 0x90500000 0x100000>;

		epn-virt-id = <0x12030000>;
		iommus = <&crypto0_atu>;
		dma-coherent;

		mpm0: mpm@c000 {
			compatible = "cortina,ca77xx-mpm";
			reg = <0xc000 0x2000>;
			epn-virt-id = <0x12030000>;
			interrupt-parent = <&gic>;
			interrupts = <GIC_SPI IRQ_GLB_CRYP0_MPM IRQ_TYPE_LEVEL_HIGH>;
		};

		trng0: clp800@18000 {
			compatible = "cortina,ca77xx-clp800";
			reg = <0x18000 0x8000>;
			epn-virt-id = <0x12030000>;
			interrupt-parent = <&gic>;
			interrupts = <GIC_SPI IRQ_GLB_CRYP0_RNG IRQ_TYPE_LEVEL_HIGH>;
		};

		spacc0_0: spacc00@40000 {
			compatible = "ca,ca8289-spacc";
			reg = <0x40000 0x40000>;
			epn-virt-id = <0x12030000>;
			interrupt-parent = <&gic>;
			interrupts = <GIC_SPI IRQ_GLB_CRYP0_0 IRQ_TYPE_LEVEL_HIGH>;
		};

		spacc0_1: spacc01@80000 {
			compatible = "ca,ca8289-spacc";
			reg = <0x80000 0x40000>;
			epn-virt-id = <0x12030001>;
			interrupt-parent = <&gic>;
			interrupts = <GIC_SPI IRQ_GLB_CRYP0_1 IRQ_TYPE_LEVEL_HIGH>;
		};

		spacc0_2: spacc02@c0000 {
			compatible = "ca,ca8289-spacc";
			reg = <0xc0000 0x40000>;
			epn-virt-id = <0x12030002>;
			interrupt-parent = <&gic>;
			interrupts = <GIC_SPI IRQ_GLB_CRYP0_2 IRQ_TYPE_LEVEL_HIGH>;
		};
	};

	crypto1: crypto@90600000 {
		compatible = "ca,ca8289-crypto";
		#address-cells = <1>;
		#size-cells = <1>;
		reg = <0x0 0x90600000 0x0 0x8000>;
		ranges = <0x0 0x0 0x90600000 0x100000>;

		epn-virt-id = <0x12030010>;
		iommus = <&crypto1_atu>;
		dma-coherent;

		mpm1: mpm@c000 {
			compatible = "cortina,ca77xx-mpm";
			reg = <0xc000 0x2000>;
			epn-virt-id = <0x12030010>;
			interrupt-parent = <&gic>;
			interrupts = <GIC_SPI IRQ_GLB_CRYP1_MPM IRQ_TYPE_LEVEL_HIGH>;
		};

		trng1: clp800@18000 {
			compatible = "cortina,ca77xx-clp800";
			reg = <0x18000 0x8000>;
			epn-virt-id = <0x12030010>;
			interrupt-parent = <&gic>;
			interrupts = <GIC_SPI IRQ_GLB_CRYP1_RNG IRQ_TYPE_LEVEL_HIGH>;
		};

		spacc1_0: spacc10@40000 {
			compatible = "ca,ca8289-spacc";
			reg = <0x40000 0x40000>;
			epn-virt-id = <0x12030010>;
			interrupt-parent = <&gic>;
			interrupts = <GIC_SPI IRQ_GLB_CRYP1_0 IRQ_TYPE_LEVEL_HIGH>;
		};

		spacc1_1: spacc11@80000 {
			compatible = "ca,ca8289-spacc";
			reg = <0x80000 0x40000>;
			epn-virt-id = <0x12030011>;
			interrupt-parent = <&gic>;
			interrupts = <GIC_SPI IRQ_GLB_CRYP1_1 IRQ_TYPE_LEVEL_HIGH>;
		};

		spacc1_2: spacc12@c0000 {
			compatible = "ca,ca8289-spacc";
			reg = <0xc0000 0x40000>;
			epn-virt-id = <0x12030012>;
			interrupt-parent = <&gic>;
			interrupts = <GIC_SPI IRQ_GLB_CRYP1_2 IRQ_TYPE_LEVEL_HIGH>;
		};
	};
```

## Documentation/devicetree/bindings/crypto/cortina-access,mercury-crypto.yaml
```yaml
# SPDX-License-Identifier: (GPL-2.0 OR BSD-2-Clause)
# Copyright 2024 Cortina-Access
%YAML 1.2
---
$id: "http://devicetree.org/schemas/crypto/cortina,mercury-crypto.yaml#"
$schema: "http://devicetree.org/meta-schemas/core.yaml#"

title: Cortina-Access Mercury Crypto Accelerator

maintainers:
  - Eason Chiang <eason.chiang@cortina-access.com>

description: |
  Device tree bindings for the Realtek Mercury Crypto accelerator,
  providing hardware support for cryptographic operations such as IPsec.

properties:
  compatible:
     const: realtek,mercury-crypto
     const: realtek,8277c-crypto

  reg:
    description: Memory regions for the crypto hardware.
    items:
      - description: Base address and size for crypto registers.
      - description: Address and size for protection control registers.
    minItems: 2
    maxItems: 2

  interrupts:
    description: Interrupt line for the crypto hardware.
    maxItems: 1

  interrupt-parent:
    description: Specifies the interrupt controller for the crypto hardware.
    $ref: /schemas/types.yaml#/definitions/phandle

required:
  - compatible
  - reg
  - interrupts
  - interrupt-parent

additionalProperties: false

examples:
  - |
/* Ipsec0 */
crypto0: crypto0@90500000 {
        compatible = "realtek,mercury-crypto";
        interrupt-parent = <&gic>;
        interrupts = <GIC_SPI IRQ_GLB_CRYPTO0_MPM IRQ_TYPE_LEVEL_HIGH>;
        reg = <0x0 0x90500000 0x0 0x1D00>,
                <0x0 0x90303090 0x0 0x4>;
        pe_ctrl_crypto_prot= <0x10>;
};

/* Ipsec1 */
crypto1: crypto1@90A00000 {
        compatible = "realtek,mercury-crypto";
        interrupt-parent = <&gic>;
        interrupts = <GIC_SPI IRQ_GLB_CRYPTO1_MPM IRQ_TYPE_LEVEL_HIGH>;
        reg = <0x0 0x90A00000 0x0 0x1D00>,
                <0x0 0x90303090 0x0 0x4>;
        pe_ctrl_crypto_prot= <0x40>;
};
```

## Documentation/devicetree/bindings/gpio/cortina-access,mercury-gpio.yaml
```yaml
# SPDX-License-Identifier: (GPL-2.0 OR BSD-2-Clause)
%YAML 1.2
---
$id: http://devicetree.org/schemas/gpio/cortina-access,gpio.yaml#
$schema: http://devicetree.org/meta-schemas/core.yaml#

title: Cortina-Access GPIO controller

maintainers:
  - Lee Jenfeng (jenfeng.lee@coritna-access.com)

properties:
  compatible:
    items:
      - enum:
          - cortina-access,mercury-gpio
  reg:
    maxItems: 1

  interrupts:
    minItems: 1
    maxItems: 32

  interrupt-controller: true

  "#interrupt-cells":
    const: 2

  clocks:
    maxItems: 1

  "#gpio-cells":
    const: 2

  ngpios:
    description:
      The number of GPIOs available on the controller implementation.
      It is 16 for the SiFive SoCs and 32 for the Canaan K210.
    minimum: 1
    maximum: 32
    default: 16

  gpio-line-names:
    minItems: 1
    maxItems: 32

  gpio-controller: true
```

## Documentation/devicetree/bindings/i2c/cortina-access,i2c.yaml
```yaml
# SPDX-License-Identifier: (GPL-2.0 OR BSD-2-Clause)
%YAML 1.2
---
$id: http://devicetree.org/schemas/i2c/cortina-access,i2c.yaml#
$schema: http://devicetree.org/meta-schemas/core.yaml#

title: I2C driver for Cortina-Access platform, Inc.

maintainers:
  - Ting Wu <ting.wu@cortina-access.com>

description:
  This hardware i2c is present on Cortina-Access platform.

properties:
  compatible:
    enum:
      - cortina-access,venus-i2c
      - cortina-access,mercury-i2c

  reg:
    maxItems: 2
    description:
      Hareware address of I2C controller

  clocks:
    maxItems: 1

  interrupts:
    maxItems: 1


required:
  - compatible
  - reg
  - clocks
  - interrupts

additionalProperties: false

examples:
  - |

/ {
	i2c0: i2c@f432917c {
		#address-cells = <1>;
		#size-cells = <0>;
		compatible = "cortina,mercury-i2c";
		reg = <0x00000000 0xf432917c 0x0 0x28>;
		reg-names = "i2c_ctrl";
		interrupt-parent = <&per_ictl>;
		interrupts = <IRQ_PER_BIW0>;
		device_type = "i2c";
		clocks = <&apb_pclk>;
		clock-frequency = <100000>;
		timeout = <1000>;
		retries = <3>;
	};
};


...
```

## Documentation/devicetree/bindings/interrupt-controller/cortina-access,per-ictl.yaml
```yaml
# SPDX-License-Identifier: (GPL-2.0 OR BSD-2-Clause)
# Copyright 2023 Cortina-Access
%YAML 1.2
---
$id: "http://devicetree.org/schemas/interrupt-controller/cortina-access,per-ictl.yaml#"
$schema: "http://devicetree.org/meta-schemas/core.yaml#"

title: Cortina-Access peripheral interrupt controller

maintainers:
  - Jason Li <jason.li@cortina-access.com>

properties:
  compatible:
    const: cortina-access,per-ictl

  reg:
    items:
      - description: Control registers base address and length

required:
  - compatible
  - reg

additionalProperties: false

examples:
  - |
    per_ictl: per_ictl@f4329004  {
				compatible = "cortina-access,per-ictl";
				reg = <0x0 0xf4329004  0x0 0x10>;
				interrupt-controller;
				#interrupt-cells = <1>;
				interrupt-parent = <&gic>;
				interrupts = <GIC_SPI IRQ_GLB_PERI IRQ_TYPE_LEVEL_HIGH>;
	};
```

## Documentation/devicetree/bindings/iommu/cortina-access,atu.yaml
```yaml
# SPDX-License-Identifier: (GPL-2.0 OR BSD-2-Clause)
%YAML 1.2
---
$id: http://devicetree.org/schemas/iommu/cortina,atu.yaml#
$schema: http://devicetree.org/meta-schemas/core.yaml#

title: Cortina Access ATU Device Tree Bindings

properties:
  compatible:
    const: cortina-access,atu

  reg:
    minItems: 2
    maxItems: 2

  reg-names:
    oneOf:
      - items:
        - const: pcie0_atu
      - items:
        - const: pcie1_atu
      - items:
        - const: pcie2_atu
      - items:
        - const: sata_atu
      - items:
        - const: sd_atu"
      - items:
        - const: usb0_atu
      - items:
        - const: usb1_atu
      - items:
        - const: pe0_atu
      - items:
        - const: pe1_atu
      - items:
        - const: crypto0_atu
      - items:
        - const: crypto1_atu

  atu-type:
    description:
      The value is 0 ~ 2. 0 is AXI_STD, 1 is AXI_PLUS, and 2 is AHB_PLUS.
    minItems: 0
    maxItems: 2

  keep-init: true
    description:
      Keep the default configuration of hardware.

  coherent-hi-addr:
    description:
      This is high 32 bits for hardware DMA coherent faric route.
    oneOf:
      - items:
        - const: CCIS0_HIGH_ADDR
      - items:
        - const: CCIS1_HIGH_ADDR

  '#iommu-cells':
    const: 0

required:
  - compatible
  - reg
  - reg-names
  - "#iommu-cells"

additionalProperties: false

examples:
  - |
      pcie0_atu: atu@f432c000 {
          compatible = "cortina-access,atu";
          reg = <0x0 0xf432c000 0x0 0x0000001c>;
          reg-names = "pcie0_atu";
          atu-type = <0>;
          coherent-hi-addr = <CCIS1_HIGH_ADDR>;
          #iommu-cells = <0>;
      };
```

## Documentation/devicetree/bindings/mailbox/cortina-access,pelog.yaml
```yaml
# SPDX-License-Identifier: (GPL-2.0 OR BSD-2-Clause)
%YAML 1.2
---
$id: http://devicetree.org/schemas/mailbox/cortina-access,pelog.yaml#
$schema: http://devicetree.org/meta-schemas/core.yaml#

title: PE log reserved memory for CA8299 from Cortina Access, Inc.

description:
  pelog_reserved provides 512KB RAM storage for PE log functionality.

  Regions in the /pelog_reserved node is referenced by the pelog device
  node by adding a memory-region property to the device node.

maintainers:
  - Ting Wu <ting.wu@cortina-access.com>

properties:
  compatible:
    const: cortina-access,pelog

  reg:
    maxItems: 1
    description:
      PE log reserved memory.

  memory-region:
    description:
      Region of memories reserved for the PE logs.

required:
  - compatible
  - memory-region
  - reg

additionalProperties: false

examples:
  - |
    reserved-memory {
        #address-cells = <2>;
        #size-cells = <2>;
        ranges;
        pelog_reserved: pelog_shm@13902000 {
              no-map;
              reg = <0x00000000 0x13902000 0x0 0x80000>;
        };
    };

    pelog@0 {
        compatible = "cortina-access,pelog"; /* PELOG */
        memory-region = <&pelog_reserved>;
    };
```

## Documentation/devicetree/bindings/mailbox/cortina-access,soft_ipc.yaml
```yaml
# SPDX-License-Identifier: (GPL-2.0 OR BSD-2-Clause)
%YAML 1.2
---
$id: http://devicetree.org/schemas/mailbox/cortina-access,soft_ipc.yaml#
$schema: http://devicetree.org/meta-schemas/core.yaml#

title: IPC controller for CA8299 from Cortina Access, Inc.

description:
  This controller is present on CA8299, providing
  the signaling between PE0/1/2/3 and ARM.

maintainers:
  - Ting Wu <ting.wu@cortina-access.com>

properties:
  compatible:
    const: cortina-access,soft_ipc

  reg:
    maxItems: 1
    description:
      Soft IRQ control registers.

  memory-region:
    description:
      Region of memories reserved for the IPC utilities.

  interrupts:
    description:
      IRQ offset in peripheral.

 pe-ipc-cpuid:
    description:
      PE processor id using the mailbox (0 to 3).
    enum: [0, 3]

required:
  - compatible
  - memory-region
  - reg
  - interrupt-parent
  - interrupts
  - pe-ipc-cpuid

additionalProperties: false

examples:
  - |
    #include <dt-bindings/soc/ca8299_irqs.h>
    #include <dt-bindings/interrupt-controller/arm-gic.h>

    /*
	   * PER_IRQ_SOFT1/2/3/4 for ARM to PE0/1/2/3
	   * PER_IRQ_SOFT0 PE0/1/2/3 to ARM
	   */
    soft_ipc: soft_ipc@0 {
      compatible = "cortina-access,soft_ipc";
	    memory-region = <&ipc_reserved>;
		  reg = <0x00000000 0xf4329000 0x0 0x38>;
		  interrupt-parent = <&per_ictl>;
		  interrupts = <IRQ_PER_SOFT0>; /*PER_IRQ_SOFT0*/
		  pe-ipc-cpuid = <0>; /*ARM CPU*/
	  };

    reserved-memory {
		  #address-cells = <2>;
		  #size-cells = <2>;
		  ranges;
      ipc_reserved: ipc_shm@13800000 {
        no-map;
        reg = <0x00000000 0x13800000 0x0 0x102000>;
        /* per PE needs 0x20400*2=0x40800 (258KB) */
      };
    };

...
```

## Documentation/devicetree/bindings/mmc/cortina-access,dw-mshc.yaml
```yaml
# SPDX-License-Identifier: GPL-2.0-only OR BSD-2-Clause
%YAML 1.2
---
$id: http://devicetree.org/schemas/mmc/cortina-access,dw-mshc.yaml#
$schema: http://devicetree.org/meta-schemas/core.yaml#

title:
  Cortina-Access SoC specific extensions to the Synopsys Designware Mobile
  Storage Host Controller

maintainers:
  - Jway Lin<jway.lin@cortina-access.com>

properties:
  compatible:
    enum:
      - cortina-access,dw-mshc

  reg:
    maxItems: 1

  interrupts:
    maxItems: 1

  clocks:
    maxItems: 2
    description:
      Handle to "biu" and "ciu" clocks for the
      bus interface unit clock and the card interface unit clock.

  clock-names:
    items:
      - const: biu
      - const: ciu

required:
  - compatible
  - reg
  - interrupts
  - clocks
  - clock-names

examples:
  - |
    #include <dt-bindings/clock/exynos5420.h>
    #include <dt-bindings/interrupt-controller/arm-gic.h>
	mmc0: mmc@f4400000 {
		compatible = "cortina-access,dw-mshc";
		#address-cells= <1>;
		#size-cells = <0>;
		reg = <0 0xf4400000 0 0x1000>;

		g_io_drv_ctrl = <0xf432007c>;
		interrupt-parent = <&gic>;
		interrupts = <0 43 4>;
		clocks = <&div_sd_clk>, <&div_sd_clk>, <&mmc_drv_clk>, <&mmc_smpl_clk>;
		clock-names = "ciu","biu","sd-drv","sd-smpl";

		fifo-depth = <128>;
		fifo-watermark-aligned;
		card-detect-delay = <200>;
		bus-width = <4>;
		cap-mmc-highspeed;
		cap-sd-highspeed;
		//iommus = <&sd_atu>;
	};
```

## Documentation/devicetree/bindings/mtd/cortina-access,nflash.yaml
```yaml
# SPDX-License-Identifier: GPL-2.0-only OR BSD-2-Clause
%YAML 1.2
---
$id: http://devicetree.org/schemas/mtd/cortina-access,nflash.yaml#
$schema: http://devicetree.org/meta-schemas/core.yaml#

title: Cortina-Access Parallel NAND Controller

maintainers:
  - hank.chen <hank0717.chen@cortina-access.com>

properties:
  compatible:
    enum:
      - cortina-access,nflash
```
