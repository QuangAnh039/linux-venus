## Documentation/devicetree/bindings/pci/cortina-access,ca8299-pcie.yaml
```yaml
# SPDX-License-Identifier: (GPL-2.0 OR BSD-2-Clause)
# Copyright 2024 Cortina-Access
%YAML 1.2
---
$id: "http://devicetree.org/schemas/pci/cortina-access,ca8299-pcie.yaml#"
$schema: "http://devicetree.org/meta-schemas/core.yaml#"

title: Cortina-Access MERCURY PCIE

maintainers:
  - Eason Chiang <eason.chiang@cortina-access.com>

properties:
  compatible:
     const: cortina-access,mercury-pcie

  reg:
    maxItems: 1

  reg-names:
    items:
      - const: glbl_regs, rc_dbi, config, iatu, serdes_phy

required:
  - compatible
  - reg
  - reg-names
  - phy-names

additionalProperties: false

examples:
  - |
    pcie0: pcie@0xf4325000 {
		compatible = "cortina-access,mercury-pcie";
		reg = <0x0 0xf4325000 0x0 0x00000800>,
		      <0x0 0xa0000000 0x0 0x00001000>,
		      <0x0 0xa0001000 0x0 0x00002000>,
		      <0x0 0xa0300000 0x0 0x00100000>,
		      <0x0 0xf4700000 0x0 0x0000FFFC>;
        reg-names = "glbl_regs", "rc_dbi", "config", "iatu","serdes_phy";

		resets = <&block_rst1 PCI0_RESET>, <&dphy_rst PHY_S0_PCIE_RESET>;
		reset-names = "core_reset", "phy_reset";

		phys = <&s0_pcie_phy0>, <&s0_pcie_phy1>;
		phy-names = "pcie-phy0", "pcie-phy1";
		#address-cells = <3>;
		#size-cells = <2>;

		device_type = "pci";
		bus-range = <0x0 0xff>;
		ranges = <0x81000000 0 0          0 0xa0003000 0 0x00010000
			/* downstream I/O */
			/* 0xa0300000 - 0xa03fffff reserved for controller */
			0x82000000 0 0xa0400000 0 0xa0400000 0 0x0fc00000>;
			/* non-prefetchable memory */

		id = <0>;
		num-viewport = <1>;
		num-lanes = <2>;
		clocks = <&gate_pcie0_clk>;
		iommus = <&pcie0_atu>;

		interrupt-parent = <&gic>;
		interrupts = <GIC_SPI IRQ_GLB_PCIE0_GIC0 IRQ_TYPE_LEVEL_HIGH>,
					/* controller interrupt */
					<GIC_SPI IRQ_GLB_PCIE0_GIC1 IRQ_TYPE_LEVEL_HIGH>,
					<GIC_SPI IRQ_GLB_PCIE0_GIC2 IRQ_TYPE_LEVEL_HIGH>,
					<GIC_SPI IRQ_GLB_PCIE0_GIC3 IRQ_TYPE_LEVEL_HIGH>;

		irq-affinity = <1>;  /*RTK wifi. Bound to CPU1. */

		/* Serdes PHY parameters */
		serdes-cfg-verA = "revA v0.2 (2024.08.26)";
		#interrupt-cells = <1>;
		interrupt-map-mask = <0 0 0 7>;
//		interrupt-map-mask = <0xffffffff 0x0>;
		interrupt-map = <0 0 0 1 &pcie0_intc 1>, /* INT A */
				<0 0 0 2 &pcie0_intc 2>, /* INT B */
				<0 0 0 3 &pcie0_intc 3>, /* INT C */
				<0 0 0 4 &pcie0_intc 4>; /* INT D */
		pcie0_intc: interrupt-controller {
			interrupt-controller;
			#address-cells = <0>;
			#interrupt-cells = <1>;
		};
	  };
    pcie1: pcie@0xf4325800 {
		compatible = "cortina-access,mercury-pcie";
		reg = <0x0 0xf4325800 0x0 0x00000800>,
		      <0x0 0xb0000000 0x0 0x00001000>,
		      <0x0 0xb0001000 0x0 0x00002000>,
		      <0x0 0xb0300000 0x0 0x00100000>,
		      <0x0 0xf4710000 0x0 0x0000FFFC>;
		reg-names = "glbl_regs", "rc_dbi", "config", "iatu","serdes_phy";

		resets = <&block_rst1 PCI1_RESET>, <&dphy_rst PHY_S1_PCIE_RESET>;
		reset-names = "core_reset", "phy_reset";

		phys = <&s1_pcie_phy0>, <&s1_pcie_phy1>;
		phy-names = "pcie-phy0", "pcie-phy1";

		#address-cells = <3>;
		#size-cells = <2>;

		device_type = "pci";
		bus-range = <0x0 0xff>;
		ranges = <0x81000000 0 0          0 0xb0003000 0 0x00010000
			/* downstream I/O */
			/* 0xb0300000 - 0xb03fffff reserved for controller */
			0x82000000 0 0xb0400000 0 0xb0400000 0 0x0fc00000>;
			/* non-prefetchable memory */

		id = <1>;
		num-viewport = <1>;
		num-lanes = <2>;
		clocks = <&gate_pcie1_clk>;
		iommus = <&pcie1_atu>;

		interrupt-parent = <&gic>;
		interrupts = <GIC_SPI IRQ_GLB_PCIE1_GIC0 IRQ_TYPE_LEVEL_HIGH>,
					/* controller interrupt */
					<GIC_SPI IRQ_GLB_PCIE1_GIC1 IRQ_TYPE_LEVEL_HIGH>,
					<GIC_SPI IRQ_GLB_PCIE1_GIC2 IRQ_TYPE_LEVEL_HIGH>,
					<GIC_SPI IRQ_GLB_PCIE1_GIC3 IRQ_TYPE_LEVEL_HIGH>;

		irq-affinity = <1>;  /*RTK wifi. Bound to CPU1. */

		/* Serdes PHY parameters */
		serdes-cfg-verA = "revA v0.2 (2024.08.26)";

		#interrupt-cells = <1>;
		interrupt-map-mask = <0 0 0 7>;
		interrupt-map = <0 0 0 1 &pcie1_intc 1>, /* INT A */
				<0 0 0 2 &pcie1_intc 2>, /* INT B */
				<0 0 0 3 &pcie1_intc 3>, /* INT C */
				<0 0 0 4 &pcie1_intc 4>; /* INT D */
		pcie1_intc: interrupt-controller {
			interrupt-controller;
			#address-cells = <0>;
			#interrupt-cells = <1>;
		};
	  };
	pcie2: pcie@f4326000 {
		compatible = "cortina-access,mercury-pcie";
		reg = <0x0 0xf4326000 0x0 0x00000800>,
		      <0x0 0xc0000000 0x0 0x00001000>,
		      <0x0 0xc0001000 0x0 0x00002000>,
		      <0x0 0xc0300000 0x0 0x00100000>,
		      <0x0 0xf4720000 0x0 0x0000FFFC>;
		reg-names = "glbl_regs", "rc_dbi", "config", "iatu","serdes_phy";

		resets = <&block_rst1 PCI2_RESET>, <&dphy_rst PHY_S2_PCIE_RESET>;
		reset-names = "core_reset", "phy_reset";

		phys = <&s2_pcie_phy0>;
		phy-names = "pcie-phy0", "pcie-phy1";

		#address-cells = <3>;
		#size-cells = <2>;

		device_type = "pci";
		bus-range = <0x0 0xff>;
		ranges = <0x81000000 0 0          0 0xc0003000 0 0x00010000
			/* downstream I/O */
			/* 0xb0300000 - 0xb03fffff reserved for controller */
			0x82000000 0 0xc0400000 0 0xc0400000 0 0x0fc00000>;
			/* non-prefetchable memory */

		id = <2>;
		num-viewport = <1>;
		num-lanes = <1>;
		clocks = <&gate_pcie2_clk>;
		iommus = <&pcie2_atu>;

		interrupt-parent = <&gic>;
		interrupts = <GIC_SPI IRQ_GLB_PCIE2_GIC0 IRQ_TYPE_LEVEL_HIGH>,
					/* controller interrupt */
					<GIC_SPI IRQ_GLB_PCIE2_GIC1 IRQ_TYPE_LEVEL_HIGH>,
					<GIC_SPI IRQ_GLB_PCIE2_GIC2 IRQ_TYPE_LEVEL_HIGH>,
					<GIC_SPI IRQ_GLB_PCIE2_GIC3 IRQ_TYPE_LEVEL_HIGH>;

		irq-affinity = <1>;  /*RTK wifi. Bound to CPU1. */

		status = "disabled";
		/* Serdes PHY parameters */
		serdes-cfg-verA = "revA v0.2 (2024.09.13)";
			mac_pset_fs = <40>;
			mac_pset_lf = <12>;
			mac_preset_cfg = /*p0 - p10, Pre, Main, Post*/
					<0 30 10>,
					<0 33 7>,
					<0 32 8>,
					<0 35 5>,
					<0 40 0>,
					<4 36 0>,
					<5 35 0>,
					<4 28 8>,
					<5 30 5>,
					<7 33 0>,
					<0 27 13>;

		#interrupt-cells = <1>;
		interrupt-map-mask = <0 0 0 7>;
		interrupt-map = <0 0 0 1 &pcie2_intc 1>, /* INT A */
				<0 0 0 2 &pcie2_intc 2>, /* INT B */
				<0 0 0 3 &pcie2_intc 3>, /* INT C */
				<0 0 0 4 &pcie2_intc 4>; /* INT D */
		pcie2_intc: interrupt-controller {
			interrupt-controller;
			#address-cells = <0>;
			#interrupt-cells = <1>;
		};
	};
pcie7: pcie@f4326800 {
		compatible = "cortina-access,mercury-pcie";
		reg = <0x0 0xf4326800 0x0 0x00000800>,
		      <0x0 0xd0000000 0x0 0x00001000>,
		      <0x0 0xd0001000 0x0 0x00002000>,
		      <0x0 0xd0300000 0x0 0x00100000>,
		      <0x0 0xf4330000 0x0 0x00000FFC>;
		reg-names = "glbl_regs", "rc_dbi", "config", "iatu","serdes_phy";

		resets = <&block_rst1 PCI7_RESET>, <&dphy_rst PHY_S7_PCIE_RESET>;
		reset-names = "core_reset", "phy_reset";

		phys = <&s7_pcie_phy0>;
		phy-names = "pcie-phy0";

		#address-cells = <3>;
		#size-cells = <2>;

		device_type = "pci";
		bus-range = <0x0 0xff>;
		ranges = <0x81000000 0 0          0 0xd0003000 0 0x00010000
			/* downstream I/O */
			/* 0xb0300000 - 0xb03fffff reserved for controller */
			0x82000000 0 0xd0400000 0 0xd0400000 0 0x07e00000>;
			/* non-prefetchable memory */

		id = <7>;
		num-viewport = <1>;
		num-lanes = <1>;
		clocks = <&gate_pcie7_clk>;
		iommus = <&pcie7_atu>;

		interrupt-parent = <&gic>;
		interrupts = <GIC_SPI IRQ_GLB_PCIE7_GIC0 IRQ_TYPE_LEVEL_HIGH>,
					/* controller interrupt */
					<GIC_SPI IRQ_GLB_PCIE7_GIC1 IRQ_TYPE_LEVEL_HIGH>,
					<GIC_SPI IRQ_GLB_PCIE7_GIC2 IRQ_TYPE_LEVEL_HIGH>,
					<GIC_SPI IRQ_GLB_PCIE7_GIC3 IRQ_TYPE_LEVEL_HIGH>;

		irq-affinity = <1>;  /*RTK wifi. Bound to CPU1. */

		status = "disabled";
		/* Serdes PHY parameters */
		serdes-cfg-verA = "revA v0.1 (2024.10.08)";
		serdes-cfg-dataA = /*S7, GEN1*/
								<0x20 0x3599>,
								<0x2c 0xbf0d>,
								<0x34 0xe726>,
								<0x38 0x5000>,
								<0x80 0x44c8>,
							/*GEN2*/
								<0x220 0x3599>,
								<0x22c 0xbf0d>,
								<0x234 0xe726>,
								<0x238 0x5000>,
								<0x280 0x44e9>,
								<0x284 0x47aa>;
		#interrupt-cells = <1>;
		interrupt-map-mask = <0 0 0 7>;
		interrupt-map = <0 0 0 1 &pcie7_intc 1>, /* INT A */
				<0 0 0 2 &pcie7_intc 2>, /* INT B */
				<0 0 0 3 &pcie7_intc 3>, /* INT C */
				<0 0 0 4 &pcie7_intc 4>; /* INT D */
		pcie7_intc: interrupt-controller {
			interrupt-controller;
			#address-cells = <0>;
			#interrupt-cells = <1>;
		};
	};

	pcie8: pcie@f4327000 {
		compatible = "cortina-access,mercury-pcie";
		reg = <0x0 0xf4327000 0x0 0x00000800>,
		      <0x0 0xd8000000 0x0 0x00001000>,
		      <0x0 0xd8001000 0x0 0x00002000>,
		      <0x0 0xd8300000 0x0 0x00100000>,
		      <0x0 0xf4331000 0x0 0x00000FFC>;
		reg-names = "glbl_regs", "rc_dbi", "config", "iatu","serdes_phy";

		resets = <&block_rst1 PCI8_RESET>, <&dphy_rst PHY_S8_PCIE_RESET>;
		reset-names = "core_reset", "phy_reset";

		phys = <&s8_pcie_phy0>;
		phy-names = "pcie-phy0";

		#address-cells = <3>;
		#size-cells = <2>;

		device_type = "pci";
		bus-range = <0x0 0xff>;
		ranges = <0x81000000 0 0          0 0xd8003000 0 0x00010000
			/* downstream I/O */
			/* 0xb0300000 - 0xb03fffff reserved for controller */
			0x82000000 0 0xd8400000 0 0xd8400000 0 0x07e00000>;
			/* non-prefetchable memory */
		id = <8>;
		num-viewport = <1>;
		num-lanes = <1>;
		clocks = <&gate_pcie8_clk>;
		iommus = <&pcie8_atu>;

		interrupt-parent = <&gic>;
		interrupts = <GIC_SPI IRQ_GLB_PCIE8_GIC0 IRQ_TYPE_LEVEL_HIGH>,
					/* controller interrupt */
					<GIC_SPI IRQ_GLB_PCIE8_GIC1 IRQ_TYPE_LEVEL_HIGH>,
					<GIC_SPI IRQ_GLB_PCIE8_GIC2 IRQ_TYPE_LEVEL_HIGH>,
					<GIC_SPI IRQ_GLB_PCIE8_GIC3 IRQ_TYPE_LEVEL_HIGH>;

		irq-affinity = <1>;  /*RTK wifi. Bound to CPU1. */

		status = "disabled";
		/* Serdes PHY parameters */
		serdes-cfg-verA = "revA v0.1 (2024.10.08)";
		serdes-cfg-dataA = /*S8, GEN1*/
								<0x20 0x3599>,
								<0x2c 0xbf0d>,
								<0x34 0xe726>,
								<0x38 0x5000>,
								<0x80 0x44c8>,
							/*GEN2*/
								<0x220 0x3599>,
								<0x22c 0xbf0d>,
								<0x234 0xe726>,
								<0x238 0x5000>,
								<0x280 0x44e9>,
								<0x284 0x47aa>;
		#interrupt-cells = <1>;
		interrupt-map-mask = <0 0 0 7>;
		interrupt-map = <0 0 0 1 &pcie8_intc 1>, /* INT A */
				<0 0 0 2 &pcie8_intc 2>, /* INT B */
				<0 0 0 3 &pcie8_intc 3>, /* INT C */
				<0 0 0 4 &pcie8_intc 4>; /* INT D */
		pcie8_intc: interrupt-controller {
			interrupt-controller;
			#address-cells = <0>;
			#interrupt-cells = <1>;
		};
	};
```

## Documentation/devicetree/bindings/phy/cortina-access,ca8289-phy.yaml
```yaml
# SPDX-License-Identifier: (GPL-2.0 OR BSD-2-Clause)
# Copyright 2024 Cortina-Access
%YAML 1.2
---
$id: "http://devicetree.org/schemas/phy/cortina-access,ca8289-phy.yaml#"
$schema: "http://devicetree.org/meta-schemas/core.yaml#"

title: Cortina-Access VENUS SoC Global PHY

maintainers:
  - Pengpeng Chen <pengpeng.chen@cortina-access.com>

properties:
  compatible:
     const: cortina-access,venus-phy

  reg:
    maxItems: 1

  reg-names:
    items:
      - const: phy_ctrl

required:
  - compatible
  - reg
  - reg-names

additionalProperties: false

examples:
  - |
    glb_phy: phy@f4320050 {
		    #address-cells = <1>;
		    #size-cells = <0>;
		    compatible = "cortina-access,venus-phy";
		    reg = <0x0 0xf4320050 0x0 0x20>;
		    reg-names = "phy_ctrl";

		    s0_pcie_phy0: phy@PHY_S0_PCIE0 {
			    reg = <PHY_S0_PCIE0>;
			    #phy-cells = <0>;
			    serdes-reg = <0 0xf4333000 0 0x1000>;
		    };

		    s0_pcie_phy1: phy@PHY_S0_PCIE1 {
			    reg = <PHY_S0_PCIE1>;
			    #phy-cells = <0>;
			    serdes-reg = <0 0xf4334000 0 0x1000>;
		    };

		    s1_pcie_phy0: phy@PHY_S1_PCIE0 {
			    reg = <PHY_S1_PCIE0>;
			    #phy-cells = <0>;
			    serdes-reg = <0 0xf4335000 0 0x1000>;
		    };

		    s1_pcie_phy1: phy@PHY_S1_PCIE1 {
			    reg = <PHY_S1_PCIE1>;
			    #phy-cells = <0>;
			    serdes-reg = <0 0xf4336000 0 0x1000>;
		    };

		    s2_pcie_phy0: phy@PHY_S2_PCIE0 {
			    reg = <PHY_S2_PCIE0>;
			    #phy-cells = <0>;
			    serdes-reg = <0 0xf4337000 0 0x1000>;
		    };
	  };
```

## Documentation/devicetree/bindings/phy/cortina-access,ca8299-phy.yaml
```yaml
# SPDX-License-Identifier: (GPL-2.0 OR BSD-2-Clause)
# Copyright 2024 Cortina-Access
%YAML 1.2
---
$id: "http://devicetree.org/schemas/phy/cortina-access,ca8299-phy.yaml#"
$schema: "http://devicetree.org/meta-schemas/core.yaml#"

title: Cortina-Access CA8299 SoC Global PHY

maintainers:
  - Pengpeng Chen <pengpeng.chen@cortina-access.com>

properties:
  compatible:
     const: cortina-access,ca8299-phy

  reg:
    maxItems: 1

  reg-names:
    items:
      - const: glb_phy_reg

required:
  - compatible
  - reg
  - reg-names

additionalProperties: false

examples:
  - |
    glb: phy@f43200b8 {
		    #address-cells = <1>;
		    #size-cells = <0>;
		    compatible = "cortina-access,ca8299-phy";
		    reg = <0x0 0xf43200b8 0x0 0x98>;
		    reg-names = "glb_phy_ctrl";

		    s0_pcie_phy: phy@PHY_S0_PCIE {
			    reg = <PHY_S0_PCIE>;
			    #phy-cells = <0>;
		    };

		    s1_pcie_phy: phy@PHY_S1_PCIE {
			    reg = <PHY_S1_PCIE>;
			    #phy-cells = <0>;
		    };

		    s2_pcie_phy: phy@PHY_S2_PCIE {
			    reg = <PHY_S2_PCIE>;
			    #phy-cells = <0>;
		    };

		    s7_pcie_phy: phy@PHY_S7_PCIE {
			    reg = <PHY_S7_PCIE>;
			    #phy-cells = <0>;
		    };

		    s8_pcie_phy: phy@PHY_S8_PCIE {
			    reg = <PHY_S8_PCIE>;
			    #phy-cells = <0>;
		    };
	  };
```
